## meta-flax/conf/layer.conf
```bitbake
# Layer configuration for meta-flax
BBPATH .= ":${LAYERDIR}"

BBFILES += "${LAYERDIR}/recipes-*/*/*.bb \
            ${LAYERDIR}/recipes-*/*/*.bbappend"

BBFILE_COLLECTIONS += "flax-layer"
BBFILE_PATTERN_flax-layer := "^${LAYERDIR}/"
LAYERSERIES_COMPAT_flax-layer := "walnascar scarthgap"
```

## meta-flax/meta-tiogapass/conf/layer.conf
```bitbake
# Layer configuration for meta-flax/meta-tiogapass
BBPATH .= ":${LAYERDIR}"

BBFILES += "${LAYERDIR}/recipes-*/*/*.bb \
            ${LAYERDIR}/recipes-*/*/*.bbappend"

BBFILE_COLLECTIONS += "flax-tiogapass-layer"
BBFILE_PATTERN_flax-tiogapass-layer := "^${LAYERDIR}/"
LAYERSERIES_COMPAT_flax-tiogapass-layer := "walnascar scarthgap"
```
